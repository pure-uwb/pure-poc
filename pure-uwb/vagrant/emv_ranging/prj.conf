## CMakeLists.txt
```
# SPDX-License-Identifier: Apache-2.0

cmake_minimum_required(VERSION 3.20.0)

set(WORKSPACE_ROOT "${CMAKE_CURRENT_SOURCE_DIR}/../../../")
set(DW_BOARD_ROOT "${WORKSPACE_ROOT}dwm3000/")
set(BOARD_ROOT "${WORKSPACE_ROOT}dwm3000/")
set(DTS_ROOT "${WORKSPACE_ROOT}dwm3000/")
set(SHIELD qorvo_dwm3000)

set(BOARD  nrf52dk_nrf52832)
find_package(Zephyr REQUIRED HINTS $ENV{ZEPHYR_BASE})
project(emv_ranging)

#set(DEVICE_TYPE TERMINAL)
configure_file(${PROJECT_SOURCE_DIR}/include/app_main.h.in app_main.h)
target_include_directories(app PUBLIC "${PROJECT_BINARY_DIR}")

message("PROJECT SOURCE DIR: ${PROJECT_SOURCE_DIR}")
target_sources(app PRIVATE ${PROJECT_SOURCE_DIR}/src/app_main.c ${PROJECT_SOURCE_DIR}/src/uwb_ranging/uwb_ranging.c ${PROJECT_SOURCE_DIR}/src/communicate/communicate.c)
#target_sources(app PRIVATE ../../main.c)
target_sources(app PRIVATE ${PROJECT_SOURCE_DIR}/src/range/range.c)
target_sources(app PRIVATE ${PROJECT_SOURCE_DIR}/src/uwb_ranging/uart_adapter.c)

target_include_directories(app PRIVATE ${PROJECT_SOURCE_DIR}/include ${PROJECT_SOURCE_DIR}/include/uwb_ranging  ${PROJECT_SOURCE_DIR}/include/communicate)
target_include_directories(app PRIVATE ${PROJECT_SOURCE_DIR}/include/range)

# DECAWAVE part
target_sources(app PRIVATE ${DW_BOARD_ROOT}/decadriver/deca_device.c)
target_sources(app PRIVATE ${DW_BOARD_ROOT}/platform/port.c)
target_sources(app PRIVATE ${DW_BOARD_ROOT}/platform/deca_sleep.c)
target_sources(app PRIVATE ${DW_BOARD_ROOT}/platform/deca_spi.c)
target_sources(app PRIVATE ${DW_BOARD_ROOT}/config_options.c)

target_sources(app PRIVATE ${DW_BOARD_ROOT}/shared_data/shared_functions.c)
target_include_directories(app PRIVATE ${DW_BOARD_ROOT})
target_include_directories(app PRIVATE ${DW_BOARD_ROOT}/decadriver/)
target_include_directories(app PRIVATE ${DW_BOARD_ROOT}/platform/)
target_include_directories(app PRIVATE ${DW_BOARD_ROOT}/compiler/)
target_include_directories(app PRIVATE ${DW_BOARD_ROOT}/shared_data/)
```

## sample.yaml
```
sample:
  name: Emv ranging
  description: Communicates with phone over uart + ranging
tests:
  samples.peripheral.lpuart:
    build_only: true
    platform_allow: nrf52dk_nrf52832 nrf52833dk_nrf52833 nrf52840dk_nrf52840 nrf9160dk_nrf9160_ns
                    nrf5340dk_nrf5340_cpuapp nrf21540dk_nrf52840
    integration_platforms:
      - nrf52dk_nrf52832
      - nrf52833dk_nrf52833
      - nrf52840dk_nrf52840
      - nrf9160dk_nrf9160_ns
      - nrf5340dk_nrf5340_cpuapp
      - nrf21540dk_nrf52840
    tags: ci_build

  samples.peripheral.lpuart_int_driven:
    build_only: true
    platform_allow: nrf52dk_nrf52832 nrf52833dk_nrf52833 nrf52840dk_nrf52840 nrf9160dk_nrf9160_ns
                    nrf5340dk_nrf5340_cpuapp nrf21540dk_nrf52840
    integration_platforms:
      - nrf52dk_nrf52832
      - nrf52833dk_nrf52833
      - nrf52840dk_nrf52840
      - nrf9160dk_nrf9160_ns
      - nrf5340dk_nrf5340_cpuapp
      - nrf21540dk_nrf52840
    tags: ci_build
    extra_configs:
      - CONFIG_NRF_SW_LPUART_INT_DRIVEN=y
```

## prj.conf
```kconfig
# nothing here
#
CONFIG_DEBUG=y

CONFIG_SPI=y

CONFIG_GPIO=y

CONFIG_LOG_BACKEND_UART=n
# CONFIG_PRINTK=y
# CONFIG_RTT_CONSOLE=y
CONFIG_USE_SEGGER_RTT=y
CONFIG_SEGGER_RTT_MAX_NUM_UP_BUFFERS=3
CONFIG_SEGGER_RTT_MAX_NUM_DOWN_BUFFERS=3
CONFIG_SEGGER_RTT_BUFFER_SIZE_UP=1024
CONFIG_SEGGER_RTT_BUFFER_SIZE_DOWN=16
CONFIG_SEGGER_RTT_PRINTF_BUFFER_SIZE=64
CONFIG_SEGGER_RTT_MODE_NO_BLOCK_SKIP=y

CONFIG_LOG_BACKEND_RTT=y
CONFIG_LOG_BACKEND_RTT_MODE_BLOCK=y
CONFIG_LOG_BACKEND_RTT_OUTPUT_BUFFER_SIZE=128
CONFIG_LOG_BACKEND_RTT_RETRY_CNT=4
CONFIG_LOG_BACKEND_RTT_RETRY_DELAY_MS=5
CONFIG_LOG_BACKEND_RTT_BUFFER=0
CONFIG_LOG_MODE_IMMEDIATE=n

CONFIG_LOG=y
CONFIG_LOG_DEFAULT_LEVEL=3
CONFIG_LOG_OVERRIDE_LEVEL=0
CONFIG_LOG_MAX_LEVEL=4
CONFIG_LOG_FUNC_NAME_PREFIX_DBG=y

CONFIG_LOG_PRINTK=y




# CONFIG_PRINTK=y

CONFIG_FPU=y
CONFIG_FP_HARDABI=y
CONFIG_FPU_SHARING=y




CONFIG_HEAP_MEM_POOL_SIZE=1024
# CONFIG_LOG_BACKEND_SHOW_COLOR=y
CONFIG_MAIN_STACK_SIZE=4096

CONFIG_THREAD_ANALYZER=y

# Enable nordic security backend and PSA APIs

CONFIG_TIMING_FUNCTIONS=y

# UART config

CONFIG_UART_ASYNC_API=y
CONFIG_UART_LINE_CTRL=y
CONFIG_UART_USE_RUNTIME_CONFIGURE=y
```

## boards/nrf52dk_nrf52832.overlay
```dts
/* SPDX-License-Identifier: LicenseRef-Nordic-5-Clause */

// &uart0 {
// 	rx-pin = <22>;
// 	tx-pin = <23>;
// 	/delete-property/ rts-pin;
// 	/delete-property/ cts-pin;
// 	compatible = "nordic,nrf-uarte";

// 	lpuart: nrf-sw-lpuart {
// 		compatible = "nordic,nrf-sw-lpuart";
// 		status = "okay";
// 		label = "LPUART";
// 		req-pin = <24>;
// 		rdy-pin = <25>;
// 	};
// };

&arduino_serial {
	label = "ARDUINO_SERIAL";
};


&gpiote {
	interrupts = <6 NRF_DEFAULT_IRQ_PRIORITY>;
};
```

## src/app_main.c
```c
/*
 * Copyright (c) 2012-2014 Wind River Systems, Inc.
 *
 * SPDX-License-Identifier: Apache-2.0
 */

#include <zephyr.h>
#include <uwb_ranging.h>
#include "app_main.h"

int main()
{	
	peripherals_init();
    spi_peripheral_init();

    k_sleep(K_MSEC(1000));
	
    payment_device_t payment_device = create_payment_device(DEVICE_TYPE);
    while(1){
        init_session(payment_device);
        uwb_ranging(payment_device);
    }
}
```
